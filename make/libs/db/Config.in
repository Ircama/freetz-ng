## make/pkgs/procps-full/Config.in
```kconfig
config FREETZ_PACKAGE_PROCPS_FULL
	bool "procps-ng 4.0.4 (full binaries)"
	default n
	help
		procps-ng - /proc filesystem utilities (full versions)
		
		This package provides the full versions of procps utilities with
		the suffix "full" to avoid conflicts with BusyBox versions.
		
		Binaries included (all with -full suffix):
		  - psfull      - process status
		  - topfull     - display Linux processes
		  - freefull    - display amount of free and used memory
		  - uptimefull  - tell how long the system has been running
		  - vmstatfull  - virtual memory statistics
		  - wfull       - show who is logged on
		  - pmapfull    - report memory map of a process
		  - pgrepfull   - look up processes based on name
		  - pkillfull   - signal processes based on name
		  - pidoffull   - find the process ID of a running program
		  - pwdxfull    - report current working directory of a process
		  - slabtopfull - display kernel slab cache information
		  - tloadfull   - graphic representation of system load average
		  - watchfull   - execute a program periodically
		  - skillfull   - send a signal or report process status
		  - snicefull   - renice a process
		  - sysctlfull  - configure kernel parameters at runtime
		  - killfull    - terminate a process
		
		Total size: ~400 KB
		
		Can be externalized to save flash memory.

if FREETZ_PACKAGE_PROCPS_FULL

menu "Binaries selection"

config FREETZ_PACKAGE_PROCPS_FULL_PS
	bool "psfull - process status"
	default y
	help
		Report a snapshot of the current processes.

config FREETZ_PACKAGE_PROCPS_FULL_TOP
	bool "topfull - display Linux processes"
	default y
	help
		Display Linux processes in real-time.

config FREETZ_PACKAGE_PROCPS_FULL_FREE
	bool "freefull - display memory usage"
	default y
	help
		Display amount of free and used memory in the system.

config FREETZ_PACKAGE_PROCPS_FULL_UPTIME
	bool "uptimefull - system uptime"
	default y
	help
		Tell how long the system has been running.

config FREETZ_PACKAGE_PROCPS_FULL_VMSTAT
	bool "vmstatfull - virtual memory statistics"
	default y
	help
		Report virtual memory statistics.

config FREETZ_PACKAGE_PROCPS_FULL_W
	bool "wfull - show who is logged on"
	default y
	help
		Show who is logged on and what they are doing.

config FREETZ_PACKAGE_PROCPS_FULL_PMAP
	bool "pmapfull - process memory map"
	default n
	help
		Report memory map of a process.

config FREETZ_PACKAGE_PROCPS_FULL_PGREP
	bool "pgrepfull - lookup processes by name"
	default n
	help
		Look up processes based on name and other attributes.

config FREETZ_PACKAGE_PROCPS_FULL_PKILL
	bool "pkillfull - signal processes by name"
	default n
	help
		Signal processes based on name and other attributes.

config FREETZ_PACKAGE_PROCPS_FULL_PIDOF
	bool "pidoffull - find process ID"
	default n
	help
		Find the process ID of a running program.

config FREETZ_PACKAGE_PROCPS_FULL_PWDX
	bool "pwdxfull - current directory of process"
	default n
	help
		Report current working directory of a process.

config FREETZ_PACKAGE_PROCPS_FULL_SLABTOP
	bool "slabtopfull - kernel slab cache info"
	default n
	help
		Display kernel slab cache information in real time.

config FREETZ_PACKAGE_PROCPS_FULL_TLOAD
	bool "tloadfull - graphical load average"
	default n
	help
		Graphic representation of system load average.

config FREETZ_PACKAGE_PROCPS_FULL_WATCH
	bool "watchfull - execute program periodically"
	default n
	help
		Execute a program periodically, showing output fullscreen.

config FREETZ_PACKAGE_PROCPS_FULL_SKILL
	bool "skillfull - send signal to processes"
	default n
	help
		Send a signal or report process status.

config FREETZ_PACKAGE_PROCPS_FULL_SNICE
	bool "snicefull - renice processes"
	default n
	help
		Renice a process.

config FREETZ_PACKAGE_PROCPS_FULL_SYSCTL
	bool "sysctlfull - kernel parameters"
	default n
	help
		Configure kernel parameters at runtime.

config FREETZ_PACKAGE_PROCPS_FULL_KILL
	bool "killfull - terminate process"
	default n
	help
		Terminate a process by PID.

endmenu

endif # FREETZ_PACKAGE_PROCPS_FULL
```

## make/pkgs/python3-cryptography/Config.in
```kconfig
config FREETZ_PACKAGE_PYTHON3_CRYPTOGRAPHY
	bool "cryptography 43.0.3 (UNSUPPORTED on MIPS - use PyCryptodome)"
	depends on FREETZ_PACKAGE_PYTHON3
	depends on FREETZ_SHOW_DEVELOPER
	select FREETZ_PACKAGE_PYTHON3_CFFI
	select FREETZ_LIB_libcrypto if !FREETZ_PACKAGE_OPENSSL
	select FREETZ_LIB_libssl if !FREETZ_PACKAGE_OPENSSL
	default n
	help
		*** WARNING: NOT SUPPORTED ON MIPS ARCHITECTURE ***
		
		cryptography requires Rust compiler for building.
		Rust removed MIPS support in version 1.72+ (year 2023).
		
		THIS PACKAGE WILL FAIL TO BUILD ON MIPS DEVICES.
		
		ALTERNATIVE: Use python3-pycryptodome instead!
		PyCryptodome provides the same cryptographic functionality
		(AES, RSA, SHA, SSL/TLS) without requiring Rust.
		
		See PYTHON3_CRYPTOGRAPHY_UNSUPPORTED.md for migration guide.
		
		---
		
		cryptography is a package which provides cryptographic recipes and
		primitives to Python developers.
		
		Features:
		  - SSL/TLS support
		  - X.509 certificate handling
		  - Symmetric encryption (AES, ChaCha20, etc.)
		  - Asymmetric encryption (RSA, ECDSA, etc.)
		  - Message digests and signatures
		  - Key derivation functions
		
		Dependencies:
		  - Python 3.x
		  - cffi (Python C Foreign Function Interface)
		  - OpenSSL >= 1.1.1 (for cryptographic operations)
		  - Rust compiler (build-time only, on host system) ← NOT AVAILABLE FOR MIPS
		
		Build complexity: IMPOSSIBLE on MIPS
		  - Requires Rust compiler with MIPS target (removed from Rust 1.72+)
		  - Will fail with error: "can't find crate for 'core'"
		
		Size: N/A (build will fail)
		
		WWW: https://cryptography.io/
```

## make/pkgs/rtorrent-cgi/Config.in
```kconfig
config FREETZ_PACKAGE_RTORRENT_CGI
	bool "rTorrent CGI"
	depends on FREETZ_PACKAGE_RTORRENT_DAEMON
	select FREETZ_BUSYBOX_START_STOP_DAEMON
	default y if FREETZ_PACKAGE_RTORRENT_DAEMON
	help
		Provides a configuration interface for rTorrent daemon.
		
		Access the configuration at http://fritz.box:81/cgi-bin/conf/rtorrent
		
		Features:
		- Start/Stop/Restart daemon control
		- Automatic startup configuration
		- Working directories setup (downloads, session, watch)
		- Peer settings (ports, encryption, DHT, PEX)
		- SCGI/RPC settings for ruTorrent integration
		- Logging configuration
```

## make/pkgs/rtorrent/Config.in
```kconfig
menuconfig FREETZ_PACKAGE_RTORRENT
	bool "rTorrent/ruTorrent"
	default n
	select FREETZ_LIB_libtorrent              if !FREETZ_PACKAGE_RTORRENT_STATIC
	select FREETZ_LIB_libxmlrpc               if !FREETZ_PACKAGE_RTORRENT_STATIC && FREETZ_PACKAGE_RTORRENT_WITH_XMLRPC
	select FREETZ_LIB_libxmlrpc_server        if !FREETZ_PACKAGE_RTORRENT_STATIC && FREETZ_PACKAGE_RTORRENT_WITH_XMLRPC
	select FREETZ_LIB_libxmlrpc_util          if !FREETZ_PACKAGE_RTORRENT_STATIC && FREETZ_PACKAGE_RTORRENT_WITH_XMLRPC
	select FREETZ_LIB_libxmlrpc_xmlparse      if !FREETZ_PACKAGE_RTORRENT_STATIC && FREETZ_PACKAGE_RTORRENT_WITH_XMLRPC
	select FREETZ_LIB_libxmlrpc_xmltok        if !FREETZ_PACKAGE_RTORRENT_STATIC && FREETZ_PACKAGE_RTORRENT_WITH_XMLRPC
	select FREETZ_LIB_libcurl                 if !FREETZ_PACKAGE_RTORRENT_STATIC
	select FREETZ_LIB_libcrypto               if !FREETZ_PACKAGE_RTORRENT_STATIC
	select FREETZ_LIB_libssl                  if !FREETZ_PACKAGE_RTORRENT_STATIC
	select FREETZ_LIB_libxml2                 if !FREETZ_PACKAGE_RTORRENT_STATIC
	select FREETZ_LIB_libncursesw             if !FREETZ_PACKAGE_RTORRENT_STATIC
	select FREETZ_LIB_libz         if !FREETZ_PACKAGE_RTORRENT_STATIC
	help
		rTorrent is a console-based BitTorrent client.
		ruTorrent is a web-based front-end for rTorrent.
		
		Includes libtorrent and libxmlrpc-c dependencies.
		Both components can be enabled independently.

if FREETZ_PACKAGE_RTORRENT

	comment "NOTE: For ruTorrent Web UI, enable PHP or PHP5 in 'Packages -> Web interface & server' first"

	config FREETZ_PACKAGE_RTORRENT_DAEMON
		bool "rTorrent daemon"
		default y
		help
			Installs rTorrent, the BitTorrent client daemon.
			Version: 0.16.5

	config FREETZ_PACKAGE_RTORRENT_WEBUI
		bool "ruTorrent web interface"
		default y
		depends on FREETZ_PACKAGE_RTORRENT_DAEMON
		depends on FREETZ_PACKAGE_PHP || FREETZ_PACKAGE_PHP5
		select FREETZ_PACKAGE_RTORRENT_WITH_XMLRPC
		select FREETZ_PACKAGE_RTORRENT_CGI
		help
			Installs ruTorrent web interface to /usr/mww/rutorrent.
			Version: 5.2.10
			
			*** IMPORTANT: Enable PHP or PHP5 package first before selecting this option ***
			
			This option requires either PHP (8.x) or PHP5 (5.6.40) to be enabled.
			If this option is not available, go to "Packages -> Web interface & server"
			and select either "PHP" or "PHP5" first.
			
			Required PHP extensions (configure in PHP menu):
			- CGI support
			- CURL
			- LIBXML
			- SESSION
			- MBSTRING
			- JSON (built-in PHP 8.x, extension in PHP 5.6)
			
			Additional requirements:
			- P7ZIP (optional, for archive management)
			- XMLRPC support (automatically enabled)
			
			Served by httpd-webcfg on port 81 at http://fritzbox:81/rutorrent/
			Configure rTorrent via: http://fritz.box:81/cgi-bin/conf/rtorrent

	config FREETZ_PACKAGE_RTORRENT_STATIC
		bool "Link statically"
		depends on FREETZ_PACKAGE_RTORRENT_DAEMON
		default n
		help
			Links rTorrent statically (larger binary, no library dependencies).

	config FREETZ_PACKAGE_RTORRENT_WITH_IPV6
		bool "With IPv6 support"
		depends on FREETZ_PACKAGE_RTORRENT_DAEMON
		depends on FREETZ_TARGET_IPV6_SUPPORT
		default y
		help
			Enables IPv6 support in rTorrent.

	config FREETZ_PACKAGE_RTORRENT_WITH_XMLRPC
		bool "With XMLRPC support"
		depends on FREETZ_PACKAGE_RTORRENT_DAEMON
		default y
		help
			Enables XMLRPC interface for remote control.
			Required for ruTorrent web interface.

	config FREETZ_PACKAGE_RTORRENT_SELECT_CGI
		bool "Select rTorrent CGI"
		select FREETZ_PACKAGE_RTORRENT_CGI
		select FREETZ_PACKAGE_RTORRENT_DAEMON
		default y
		help
			Configuration web interface for Freetz at http://fritz.box:81/cgi-bin/conf/rtorrent
			Allows to configure rTorrent daemon settings, directories, bandwidth, and SCGI socket.

endif # FREETZ_PACKAGE_RTORRENT
```
