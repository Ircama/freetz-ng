## make/libs/db/Config.in
```kconfig
config FREETZ_LIB_libdb
	bool "Berkeley DB library (libdb.so)"
	depends on FREETZ_TARGET_BITS_32
	select FREETZ_LIB_libpthread if FREETZ_TARGET_UCLIBC_HAS_multiple_libs
	default n
	help
		The Berkeley database library.
```

## make/libs/libxml2/Config.in
```kconfig
config FREETZ_LIB_libxml2
	bool "libxml2 (libxml2.so)"
	select FREETZ_LIB_libiconv    if FREETZ_TARGET_UCLIBC_0_9_28
	select FREETZ_LIB_libpthread  if FREETZ_TARGET_UCLIBC_HAS_multiple_libs
	select FREETZ_LIB_libm        if FREETZ_TARGET_UCLIBC_HAS_multiple_libs
	select FREETZ_LIB_libz
	default n
	help
		XML toolkit from the GNOME project

if FREETZ_LIB_libxml2

config FREETZ_LIB_libxml2_WITH_EXTENDED_FEATURES
	bool "Build with extended features (non-minimal)"
	default n
	help
		Build libxml2 with extended XML features (--with-minimum=no).
		
		This enables additional XML features and APIs beyond the minimal
		build, but does not include HTML support (see separate option below).
		Required by some applications like PHP for full functionality.
		
		Size impact: Adds approximately 200-300 KB to libxml2.so
		
		Note: Automatically enabled by PHP if full XML support is requested.
		Disabling will build a minimal libxml2 (--with-minimum=yes) which
		may cause compatibility issues with some applications.

config FREETZ_LIB_libxml2_WITH_HTML
	bool "Build with HTML support"
	default n
	help
		Adds html parsing capability to libxml2. This increases the size of
		libxml2 by 120kB. Html parsing is required to build libxslt.

config FREETZ_LIB_libxml2_WITH_TREE
	bool "Build with tree manipulation API"
	default n
	help
		Enables the tree manipulation API in libxml2 (--with-tree=yes).
		This provides functions for creating, modifying, and traversing
		XML document trees.
		
		Required by:
		- XML Schema validation (--with-schemas)
		- PHP DOM extension
		- Applications that need to manipulate XML trees
		
		Size impact: Minimal (most code is already included in base build)
		
		Note: Automatically enabled by PHP when DOM support is requested.

config FREETZ_LIB_libxml2_WITH_RELAXNG
	bool "Build with Relax-NG support"
	default n
	help
		Enables Relax-NG schema validation support (--with-relaxng=yes).
		Relax-NG is an alternative to XML Schema for validating XML documents.
		
		Required by:
		- PHP's DOMDocument::relaxNGValidate() methods
		- Applications using Relax-NG validation
		
		Dependencies:
		- Requires --with-tree=yes (tree manipulation API)
		- Included in --with-schemas=yes (XML Schema support)
		
		Size impact: Adds approximately 50-80 KB to libxml2.so
		
		Note: Automatically enabled by PHP when DOM support is requested.

endif # FREETZ_LIB_libxml2
```

## make/pkgs/autotools/Config.in
```kconfig
config FREETZ_PACKAGE_AUTOTOOLS
	bool "autotools (autoconf) 2.72"
	select FREETZ_PACKAGE_MICROPERL
	default n
	help
		GNU autotools - autoconf suite for generating configure scripts

		autoconf is a tool for producing configure scripts for building,
		installing and packaging software on computer systems where a
		Posix shell is available.
```

## make/pkgs/binutils-tools/Config.in
```kconfig
menuconfig FREETZ_PACKAGE_BINUTILS_TOOLS
	bool "binutils 2.41 - Binary analysis and manipulation toolkit"
	default n
	help
		Collection of essential tools for analyzing and manipulating ELF binaries.
		All tools are selected by default for convenience.
		
		Total size with all tools: ~1.5MB
		Can be externalized to save flash memory.

if FREETZ_PACKAGE_BINUTILS_TOOLS

config FREETZ_PACKAGE_BINUTILS_TOOLS_READELF
	bool "readelf - Display information about ELF files"
	default y
	help
		Displays detailed information about ELF (Executable and Linkable Format) files,
		including headers, sections, symbols, and more.

config FREETZ_PACKAGE_BINUTILS_TOOLS_OBJDUMP
	bool "objdump - Display information from object files"
	default y
	help
		Displays information from object files, including disassembly,
		section headers, and symbol tables.

config FREETZ_PACKAGE_BINUTILS_TOOLS_OBJCOPY
	bool "objcopy - Copy and translate object files"
	default y
	help
		Copies and translates object files. Can be used to convert between
		different object file formats or modify sections.

config FREETZ_PACKAGE_BINUTILS_TOOLS_NM
	bool "nm - List symbols from object files"
	default y
	help
		Lists symbols from object files, useful for debugging and understanding
		which symbols are exported or required by a binary.

config FREETZ_PACKAGE_BINUTILS_TOOLS_STRINGS
	bool "strings - Print printable character strings"
	default y
	help
		Prints sequences of printable characters from files. Very useful for
		analyzing binaries and finding hardcoded strings.

config FREETZ_PACKAGE_BINUTILS_TOOLS_AR
	bool "ar - Create, modify, and extract from archives"
	default y
	help
		Maintains groups of files as a single archive file. Commonly used
		for creating static libraries (.a files).

config FREETZ_PACKAGE_BINUTILS_TOOLS_RANLIB
	bool "ranlib - Generate index to archive contents"
	default y
	help
		Generates an index to the contents of an archive and stores it in the archive.
		Used with static libraries created by 'ar'.

config FREETZ_PACKAGE_BINUTILS_TOOLS_STRIP
	bool "strip - Remove symbols from object files"
	default y
	help
		Removes debugging symbols and other unnecessary information from object files,
		reducing their size. Note: BusyBox already provides a 'strip' command.

config FREETZ_PACKAGE_BINUTILS_TOOLS_ADDR2LINE
	bool "addr2line - Convert addresses to file names and line numbers"
	default y
	help
		Converts addresses into file names and line numbers. Useful for debugging
		crash dumps and understanding stack traces.

config FREETZ_PACKAGE_BINUTILS_TOOLS_SIZE
	bool "size - Display section sizes in binary files"
	default y
	help
		Displays the sizes of sections inside binary files. Useful for understanding
		memory usage and optimizing binary size.

endif # FREETZ_PACKAGE_BINUTILS_TOOLS
```

## make/pkgs/bzip2/Config.in
```kconfig
config FREETZ_PACKAGE_BZIP2
	bool "bzip2"
	select FREETZ_LIB_libbz2 if !FREETZ_PACKAGE_BZIP2_STATIC
	default n
	help
		bzip2 is a freely available, patent free, high-quality data compressor.

if FREETZ_PACKAGE_BZIP2

	config FREETZ_PACKAGE_BZIP2_STATIC
		bool "Link statically"
		default n
		help
			Link bzip2 binary statically

endif # FREETZ_PACKAGE_BZIP2
```

## make/pkgs/gcc-toolchain/Config.in
```kconfig
config FREETZ_PACKAGE_GCC_TOOLCHAIN
	bool "GCC Toolchain (Native Compiler from Build System)"
	depends on EXTERNAL_ENABLED
	select FREETZ_LIB_libgcc_s
	select FREETZ_PACKAGE_BINUTILS if !FREETZ_PACKAGE_GCC_TOOLCHAIN_MINIMAL
	default n
	help
		Install the GCC compiler toolchain on Fritz!Box for native compilation.
		
		This package takes the already-compiled GCC from the build toolchain
		and packages it for installation on the target device.
		
		WARNING: Size ~200-250 MB. MUST be externalized to USB storage.
		
		Perfect for:
		- Building Python C extension modules (pip install --no-binary)
		- On-device C/C++ development
		- Compiling small programs directly on router
		
		After installation, externalize to USB:
		  Files in: /tmp/flash/gcc-toolchain/
		  Move to:  /var/media/ftp/uStor01/freetz-external/

if FREETZ_PACKAGE_GCC_TOOLCHAIN

	config FREETZ_PACKAGE_GCC_TOOLCHAIN_MINIMAL
		bool "Minimal installation (GCC + essential tools only)"
		default n
		help
			Install only GCC compiler and essential compilation tools.
			Saves ~50 MB but may lack some development utilities.
			
			Minimal includes:
			- gcc, g++
			- ld, as (linker and assembler)
			- ar, ranlib (archive tools)
			
			Full installation additionally includes:
			- objdump, objcopy, nm
			- strings, readelf, addr2line
			- gcov, gprof

	config FREETZ_PACKAGE_GCC_TOOLCHAIN_HEADERS
		bool "Include development headers"
		default y
		help
			Include C/C++ standard library headers and Python headers.
			Required for compiling most programs and Python extensions.
			
			Size: ~20 MB
			
			Disable only if you're copying pre-compiled binaries.

	config FREETZ_PACKAGE_GCC_TOOLCHAIN_PYTHON_HEADERS
		bool "Include Python development headers"
		default y
		depends on FREETZ_PACKAGE_PYTHON && FREETZ_PACKAGE_GCC_TOOLCHAIN_HEADERS
		help
			Include Python.h and development headers.
			Essential for building Python C extension modules.
			
			Size: ~3 MB

endif # FREETZ_PACKAGE_GCC_TOOLCHAIN
```

## make/pkgs/gcc/Config.in
```kconfig
config FREETZ_PACKAGE_GCC
	bool "GCC (Native Compiler Toolchain)"
	depends on EXTERNAL_ENABLED
	select FREETZ_PACKAGE_GNU_MAKE
	select FREETZ_LIB_libgcc_s
	default n
	help
		GCC (GNU Compiler Collection) - Native compiler toolchain for on-device
		compilation. Perfect for building Python wheels, C/C++ programs, and
		development directly on Fritz!Box.
		
		WARNING: This package is ~250 MB and MUST be externalized to USB storage.
		
		Includes:
		- GCC (C compiler)
		- G++ (C++ compiler)
		- Binutils (ld, as, ar, ranlib, etc.)
		- Standard C/C++ headers
		- Runtime libraries (libgcc, libstdc++)
		- GNU Make
		
		Use cases:
		- Build Python C extension modules (cffi, pycrypto, etc.)
		- Compile C/C++ programs on-device
		- On-the-fly development without cross-compilation
		
		After installation, externalize to USB:
		  Files in: /tmp/flash/gcc/
		  Move to:  /var/media/ftp/uStor01/freetz-external/gcc/

if FREETZ_PACKAGE_GCC

	config FREETZ_PACKAGE_GCC_CPP
		bool "Include C++ compiler (g++)"
		default y
		help
			Include g++ C++ compiler and libstdc++ library.
			Adds ~50 MB to package size.
			
			Disable if you only need C compilation.

	config FREETZ_PACKAGE_GCC_FORTRAN
		bool "Include Fortran compiler (gfortran)"
		default n
		help
			Include gfortran Fortran compiler.
			Adds ~30 MB to package size.
			
			Only needed for scientific computing packages.

	config FREETZ_PACKAGE_GCC_PYTHON_HEADERS
		bool "Include Python development headers"
		default y
		depends on FREETZ_PACKAGE_PYTHON
		help
			Include Python.h and development headers.
			Required for building Python C extension modules.
			
			Size: ~3 MB

	config FREETZ_PACKAGE_GCC_STRIP_BINARIES
		bool "Strip compiler binaries"
		default y
		help
			Strip debug symbols from GCC binaries to reduce size.
			Reduces size by ~40% but makes debugging GCC itself harder.
			
			Recommended: Yes

	config FREETZ_PACKAGE_GCC_DEBUG_SYMBOLS
		bool "Include debug symbols"
		default n
		depends on !FREETZ_PACKAGE_GCC_STRIP_BINARIES
		help
			Keep debug symbols in compiler binaries.
			Increases size significantly (~100 MB extra).
			
			Only for GCC development/debugging.

endif # FREETZ_PACKAGE_GCC
```

## make/pkgs/microperl/Config.in
```kconfig
config FREETZ_PACKAGE_MICROPERL
	bool "microperl (binary only)"
	default n
	help
		Perl without operating-specific functions such as readdir.

if FREETZ_PACKAGE_MICROPERL

	choice
		prompt "Version"
		default FREETZ_PACKAGE_MICROPERL_VERSION_5_38

		config FREETZ_PACKAGE_MICROPERL_VERSION_5_10
			bool "5.10.1 (legacy)"

		config FREETZ_PACKAGE_MICROPERL_VERSION_5_38
			bool "5.38.2 (stable)"

	endchoice

endif # FREETZ_PACKAGE_MICROPERL

config FREETZ_PACKAGE_MICROPERL_MODULES
	string "microperl modules"
	default "strict.pm warnings.pm warnings/register.pm constant.pm Exporter.pm Exporter/Heavy.pm Carp.pm Errno.pm POSIX.pm Storable.pm Fcntl.pm Encode.pm Cwd.pm overload.pm File/Spec.pm File/stat.pm Class/Struct.pm Data/Dumper.pm File/Temp.pm Getopt/Long.pm IO/File.pm Scalar/Util.pm"
	depends on FREETZ_PACKAGE_MICROPERL
	help
		List of microperl modules to copy to the rootfs.
		E.g.
		warnings.pm warnings/register.pm strict.pm constant.pm vars.pm
		Exporter.pm Exporter/Heavy.pm Carp.pm Getopt/Long.pm
```

## make/pkgs/nodejs/Config.in
```kconfig
config FREETZ_PACKAGE_NODEJS
	bool "Node.js 25.2.1"
	select FREETZ_LIB_libz
	select FREETZ_LIB_libcrypto
	select FREETZ_LIB_libssl
	default n
	help
		Node.js is a JavaScript runtime built on Chrome's V8 JavaScript engine.
```

## make/pkgs/patchelf/Config.in
```kconfig
config FREETZ_PACKAGE_PATCHELF
	bool "patchelf 0.18.0 - Modify ELF executables and libraries"
	select FREETZ_STDCXXLIB_FORCE_GNULIBSTDCXX
	select FREETZ_LIB_STDCXXLIB
	default n
	help
		Modifies existing ELF executables and libraries. Can change the interpreter,
		RPATH, and other ELF metadata.
		
		Useful for modifying binaries to use different dynamic linker paths or
		library search paths (RPATH/RUNPATH).
		
		Note: This tool requires GNU libstdc++ (will be automatically installed
		to /usr/lib/freetz/)
		
		Homepage: https://github.com/NixOS/patchelf
```
